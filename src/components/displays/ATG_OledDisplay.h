#pragma once
// Not part of <ATGENXlib.h> (pulls in Wire):
//   #include <components/displays/ATG_OledDisplay.h>

#include <Arduino.h>
#include <Wire.h>
#include "../base/ATG_ComponentBase.h"
#include "../../core/ATG_Time.h"

namespace atg {

/**
 * SSD1306 OLED (128×64 or 128×32, I2C) in text mode: a 16-column grid of 8×8
 * cells (8 or 4 rows). Uses ~260 bytes of RAM instead of the 1 KB frame buffer
 * graphics libraries need, so it fits next to other modules on an UNO.
 *
 *   OledDisplay screen;                      // 0x3C, 128×64
 *   void draw(OledDisplay& s) {
 *     s.print(0, 0, "Temp:");
 *     s.print(0, 2, room.temperatureC(), 1, "\xB0" "C", 2);   // 2× size
 *   }
 *   screen.onRender(draw);                   // redrawn every refreshMs
 *
 * Only cells that changed are sent over I2C, so updates are quick and loop()
 * stays responsive. '°' (UTF-8 or 0xB0) is supported.
 */
class OledDisplay : public ComponentBase {
public:
  using RenderFn = void (*)(OledDisplay&);

  static constexpr uint8_t COLS = 16;
  static constexpr uint8_t MAX_ROWS = 8;

  explicit OledDisplay(uint8_t address = 0x3C, uint8_t height = 64, uint16_t refreshMs = 250)
  : ComponentBase(0xFF), _addr(address), _rows(height <= 32 ? 4 : 8), _refreshMs(refreshMs) {}

  const __FlashStringHelper* name() const override { return F("ATG_Oled"); }

  Result begin(Runtime& rt) override {
    (void)rt;
    Wire.begin();
    Wire.setClock(400000);
    const uint8_t init[] = {
      0xAE,                         // display off
      0xD5, 0x80,                   // clock
      0xA8, (uint8_t)(_rows * 8 - 1), // multiplex
      0xD3, 0x00,                   // offset
      0x40,                         // start line 0
      0x8D, 0x14,                   // charge pump on
      0x20, 0x02,                   // page addressing mode
      0xA1, 0xC8,                   // segment remap + COM scan dec (normal orientation)
      0xDA, (uint8_t)(_rows == 8 ? 0x12 : 0x02),
      0x81, 0xCF,                   // contrast
      0xD9, 0xF1,                   // pre-charge
      0xDB, 0x40,                   // VCOMH
      0xA4, 0xA6,                   // resume RAM, normal (not inverted)
      0xAF,                         // display on
    };
    for (uint8_t i = 0; i < sizeof(init); i++) command(init[i]);
    // blank the panel and mark everything clean
    for (uint8_t r = 0; r < _rows; r++) {
      for (uint8_t c = 0; c < COLS; c++) {
        _grid[r][c] = ' ';
        _shown[r][c] = 0;
      }
    }
    flush();
    _last = nowMs() - _refreshMs;
    return Result::Ok;
  }

  void tick(Runtime& rt) override {
    (void)rt;
    if (!elapsed(_last, _refreshMs)) return;
    _last = nowMs();
    if (_render) {
      clear();
      _render(*this);
    }
    flush();
  }

  void onRender(RenderFn fn) { _render = fn; }
  uint8_t rows() const { return _rows; }

  /** Blank the text grid (sent on the next refresh). */
  void clear() {
    for (uint8_t r = 0; r < _rows; r++)
      for (uint8_t c = 0; c < COLS; c++) _grid[r][c] = ' ';
  }

  /** Text at (col, row) in 8×8 cells; size 2 makes each glyph 2×2 cells. */
  void print(uint8_t col, uint8_t row, const char* text, uint8_t size = 1) {
    const bool big = size >= 2;
    for (const char* p = text; *p && col < COLS && row < _rows; p++) {
      uint8_t ch = (uint8_t)*p;
      if (ch == 0xC2) continue;            // UTF-8 lead byte of '°'
      if (ch == 0xB0) ch = DEGREE;          // '°'
      else if (ch < 32 || ch > 126) ch = '?';
      if (big) {
        if (col + 1 >= COLS || row + 1 >= _rows) break;
        _grid[row][col] = (char)(ch | BIG);
        _grid[row][col + 1] = _grid[row + 1][col] = _grid[row + 1][col + 1] = COVERED;
        col += 2;
      } else {
        _grid[row][col++] = (char)ch;
      }
    }
  }
  void print(uint8_t col, uint8_t row, const String& text, uint8_t size = 1) { print(col, row, text.c_str(), size); }

  /** label + number + unit, e.g. print(0, 0, temp, 1, "C"). */
  void print(uint8_t col, uint8_t row, float value, uint8_t decimals, const char* unit = "", uint8_t size = 1) {
    char buf[20];
    dtostrf(value, 1, decimals, buf);
    String s(buf);
    s += unit;
    print(col, row, s.c_str(), size);
  }

private:
  static constexpr char DEGREE = 0x7F;   // glyph slot used for '°'
  static constexpr char BIG = (char)0x80;
  static constexpr char COVERED = 0x01;  // cell drawn by a neighbouring 2× glyph

  void command(uint8_t c) {
    Wire.beginTransmission(_addr);
    Wire.write(0x00);
    Wire.write(c);
    Wire.endTransmission();
  }

  void setCursor(uint8_t page, uint8_t x) {
    Wire.beginTransmission(_addr);
    Wire.write(0x00);
    Wire.write(0xB0 | page);
    Wire.write(0x00 | (x & 0x0F));
    Wire.write(0x10 | (x >> 4));
    Wire.endTransmission();
  }

  static uint8_t glyphColumn(uint8_t ch, uint8_t x) {
    if (x >= 5 || ch < 32 || ch > 127) return 0;
    return pgm_read_byte(&font()[(ch - 32) * 5 + x]);
  }

  // Spread the 4 bits of a nibble over a byte (each bit doubled vertically).
  static uint8_t stretch(uint8_t nibble) {
    uint8_t out = 0;
    for (uint8_t i = 0; i < 4; i++)
      if (nibble & (1 << i)) out |= 3 << (i * 2);
    return out;
  }

  void drawSmall(uint8_t row, uint8_t col, uint8_t ch) {
    setCursor(row, col * 8);
    Wire.beginTransmission(_addr);
    Wire.write(0x40);
    for (uint8_t x = 0; x < 8; x++) Wire.write(glyphColumn(ch, x));
    Wire.endTransmission();
  }

  void drawBig(uint8_t row, uint8_t col, uint8_t ch) {
    for (uint8_t half = 0; half < 2; half++) {
      setCursor(row + half, col * 8);
      Wire.beginTransmission(_addr);
      Wire.write(0x40);
      for (uint8_t x = 0; x < 16; x++) {
        const uint8_t g = glyphColumn(ch, x / 2);
        Wire.write(stretch(half ? g >> 4 : g & 0x0F));
      }
      Wire.endTransmission();
    }
  }

  void flush() {
    for (uint8_t r = 0; r < _rows; r++) {
      for (uint8_t c = 0; c < COLS; c++) {
        const char want = _grid[r][c];
        if (want == _shown[r][c]) continue;
        if (want == COVERED) {
          _shown[r][c] = want; // pixels belong to the 2× glyph that covers it
          continue;
        }
        if (want & BIG) {
          drawBig(r, c, (uint8_t)(want & 0x7F));
          _shown[r][c] = want;
        } else {
          drawSmall(r, c, (uint8_t)want);
          _shown[r][c] = want;
          // a cell that used to be covered by a 2× glyph must be redrawn too
        }
      }
    }
    // Cells freed from a 2× glyph were marked COVERED in _shown: if they now hold
    // normal text the loop above redraws them because the values differ.
  }

  uint8_t _addr;
  uint8_t _rows;
  uint16_t _refreshMs;
  ms_t _last = 0;
  RenderFn _render = nullptr;
  char _grid[MAX_ROWS][COLS];
  char _shown[MAX_ROWS][COLS];

  // Classic 5×7 font, ASCII 32..126 plus '°' at 127. Function-local so the
  // header can be included from several .cpp files without duplicate symbols.
  static const uint8_t* font() {
    static const uint8_t F[] PROGMEM = {
    0x00,0x00,0x00,0x00,0x00, 0x00,0x00,0x5F,0x00,0x00, 0x00,0x07,0x00,0x07,0x00, 0x14,0x7F,0x14,0x7F,0x14,
    0x24,0x2A,0x7F,0x2A,0x12, 0x23,0x13,0x08,0x64,0x62, 0x36,0x49,0x55,0x22,0x50, 0x00,0x05,0x03,0x00,0x00,
    0x00,0x1C,0x22,0x41,0x00, 0x00,0x41,0x22,0x1C,0x00, 0x08,0x2A,0x1C,0x2A,0x08, 0x08,0x08,0x3E,0x08,0x08,
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    0x00,0x00,0x7F,0x00,0x00, 0x00,0x41,0x36,0x08,0x00, 0x10,0x08,0x08,0x10,0x08, 0x00,0x06,0x09,0x09,0x06,
  };
    return F;
  }
};



} // namespace atg
